## boards/arm/modulink_central_v2/Kconfig.board
```kconfig
# stolen from https://github.com/zmkfirmware/zmk/blob/main/app/boards/arm/nice_nano/Kconfig.board

config BOARD_MODULINK_CENTRAL_V2
    bool "ModuLink Central v2"
    depends on SOC_NRF52840_QIAA
```

## boards/arm/modulink_central_v2/Kconfig.defconfig
```kconfig
# stolen from https://github.com/zmkfirmware/zmk/blob/main/app/boards/arm/nice_nano/Kconfig.defconfig

if BOARD_MODULINK_CENTRAL_V2

config SOC_NRF52840_QIAA
    default y

config BOARD
    default "ModuLink Central v2"

if USB_DEVICE_STACK

config USB_NRFX
    default y

endif # USB_DEVICE_STACK

config BT_CTLR
    default BT

endif # BOARD_MODULINK_CENTRAL_V2
```

## boards/arm/modulink_central_v2/board.yml
```yaml
# Generated based on Zephyr board porting guide

board:
  name: modulink_central_v2
  socs:
    - name: nrf52840
```
